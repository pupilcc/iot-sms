## main/Kconfig.projbuild
```kconfig
menu "Application Configuration"

    choice APP_MODEM_FIRMWARE
        prompt "4G Modem Firmware Type"
        default APP_MODEM_FIRMWARE_AT
        help
            Firmware type running on the 4G Cat.1 modem.
            AT firmware: standard AT command interface (+CMT URC for SMS).
            Yinerda DTU firmware: transparent firmware using "config,xxx"
            serial commands (SMS reported as config,sms,ok,<number>,<UTF-8 hex>).

        config APP_MODEM_FIRMWARE_AT
            bool "AT firmware"

        config APP_MODEM_FIRMWARE_DTU
            bool "Yinerda DTU firmware"
    endchoice

    config APP_WIFI_SSID
        string "WiFi SSID"
        default "YOUR_WIFI_SSID"
        help
            SSID of the Wi-Fi network to connect to.

    config APP_WIFI_PASSWORD
        string "WiFi Password"
        default "YOUR_WIFI_PASSWORD"
        help
            Password of the Wi-Fi network.

    config APP_UART_PORT_NUM
        int "UART Port Number for 4G Modem"
        default 1
        range 0 2
        help
            UART port to use for communication with 4G Cat.1 modem. (ESP32C3 has UART0, UART1)

    config APP_UART_TXD
        int "UART TXD Pin for 4G Modem"
        default 0
        help
            GPIO pin for UART TX (connects to 4G modem RX).
            Avoid GPIO21/GPIO20, which are the ESP32-C3 UART0 console default pins.

    config APP_UART_RXD
        int "UART RXD Pin for 4G Modem"
        default 1
        help
            GPIO pin for UART RX (connects to 4G modem TX).
            Avoid GPIO21/GPIO20, which are the ESP32-C3 UART0 console default pins.

    config APP_UART_BAUD_RATE
        int "UART Baud Rate for 4G Modem"
        default 115200
        help
            Baud rate for UART communication with 4G Cat.1 modem.

    config APP_MQTT_BROKER_URI
        string "MQTT Broker URI"
        default "mqtt://broker.emqx.io:1883"
        help
            URI of the MQTT broker (e.g., mqtt://broker.emqx.io:1883).

    config APP_MQTT_TOPIC_SMS
        string "MQTT Topic for SMS"
        default "esp32/sms"
        help
            MQTT topic to publish received SMS messages.

    config APP_SIM_PHONE_NUMBER
        string "SIM Card Phone Number"
        default ""
        help
            Phone number of the SIM card in this device (e.g., "+8613800138000"). Leave empty if unknown.

    config APP_SNTP_TIMEZONE
        string "Timezone"
        default "UTC0"
        help
            Timezone string in POSIX format (e.g., "UTC0" for UTC, "CST-8" for China Standard Time UTC+8, "EST5EDT,M3.2.0/2,M11.1.0" for US Eastern Time).

    config APP_DEVICE_NAME
        string "Device Name"
        default ""
        help
            Custom identifier for this device (e.g., "sms-gw-01"), used as the
            "device" field/label in remote logs and metrics. Leave empty to
            fall back to an ID derived from the Wi-Fi MAC (esp32c3-xxxxxx).

    config APP_REMOTE_LOG_ENABLE
        bool "Enable remote log forwarding over MQTT"
        default y
        help
            Forward ESP_LOG output to the MQTT broker in JSON batches.
            Local console logging is unaffected.

    config APP_MQTT_TOPIC_LOG
        string "MQTT Topic for log batches"
        depends on APP_REMOTE_LOG_ENABLE
        default "esp32/log"
        help
            MQTT topic to publish batched log lines (QoS 0).

    config APP_REMOTE_LOG_LEVEL
        int "Remote log minimum level (1=ERROR 2=WARN 3=INFO 4=DEBUG 5=VERBOSE)"
        depends on APP_REMOTE_LOG_ENABLE
        range 1 5
        default 4
        help
            Only log lines at this level or more severe are forwarded remotely.
            Local console logging is unaffected. Note that levels above
            CONFIG_LOG_MAXIMUM_LEVEL are compiled out and can never be forwarded.

    config APP_MQTT_TOPIC_METRICS
        string "MQTT Topic for device metrics"
        default "esp32/metrics"
        help
            MQTT topic to publish periodic device metrics (QoS 0).

    config APP_METRICS_INTERVAL_S
        int "Device metrics publish interval (seconds)"
        default 60
        help
            Interval between device metrics publications.

endmenu
```

## sdkconfig.defaults
```kconfig
# Wi-Fi Configuration
CONFIG_ESP_WIFI_SSID="YOUR_WIFI_SSID"
CONFIG_ESP_WIFI_PASSWORD="YOUR_WIFI_PASSWORD"
CONFIG_ESP_MAXIMUM_RETRY=10
CONFIG_ESP_WIFI_AUTH_WPA2_PSK=y

# UART Configuration
CONFIG_APP_UART_PORT_NUM=1
CONFIG_APP_UART_TXD=21
CONFIG_APP_UART_RXD=20
CONFIG_APP_UART_BAUD_RATE=115200

# MQTT Configuration
CONFIG_BROKER_URL="mqtt://broker.emqx.io:1883" # This is the default from the example, we'll map our APP_MQTT_BROKER_URI to it.
CONFIG_APP_MQTT_BROKER_URI="mqtt://broker.emqx.io:1883"
CONFIG_APP_MQTT_TOPIC_SMS="esp32/sms"

# Log levels (optional, for debugging)
CONFIG_LOG_DEFAULT_LEVEL_INFO=y
CONFIG_LOG_MAXIMUM_LEVEL=V
CONFIG_LOG_COLORS=y
```
